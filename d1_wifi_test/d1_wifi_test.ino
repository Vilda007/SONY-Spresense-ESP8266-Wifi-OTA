// d1_wifi_test.ino — minimal WiFi-only test for D1 mini Pro.
//
// Boots, prints SMOKE_BOOT, then attempts WiFi.connect() and prints
// SMOKE_WIFI_OK or SMOKE_WIFI_FAIL. No relay, no Serial, no String, no
// HTTP. The goal is to isolate "does WiFi.begin() crash on this chip?"
// from everything else.
//
// FQBN: esp8266:esp8266:d1_mini:xtal=80,eesz=4M1M,ip=lm2f,baud=115200

#include <ESP8266WiFi.h>

// TEST_SSID / TEST_PASS from the git-ignored header generated by
// tools/gen_test_creds.py (avoids broken -D string-macro quoting on Windows).
#if __has_include("test_creds.h")
  #include "test_creds.h"
#endif
#ifndef TEST_SSID
#define TEST_SSID ""
#endif
#ifndef TEST_PASS
#define TEST_PASS ""
#endif

void setup() {
  Serial.begin(115200);
  delay(200);
  Serial.println(F("SMOKE_BOOT"));
  Serial.print(F("ChipID=")); Serial.println(ESP.getChipId());
  Serial.print(F("FlashRealSize=")); Serial.println(ESP.getFlashChipRealSize());
  Serial.print(F("Heap=")); Serial.println(ESP.getFreeHeap());

  Serial.println(F("SMOKE_WIFI_BEGIN"));
  Serial.print(F("SSID_LEN=")); Serial.println(strlen(TEST_SSID));
  Serial.print(F("SSID=")); Serial.println(TEST_SSID);

  // 1) SCAN — exercises the radio without attempting to associate. If this
  //    wdt-resets or finds zero networks, the radio / PHY init is the problem.
  Serial.println(F("SCAN_START"));
  WiFi.persistent(false);
  WiFi.mode(WIFI_STA);
  int n = WiFi.scanNetworks(false, false);
  Serial.print(F("SCAN_FOUND ")); Serial.print(n); Serial.println(F(" networks"));
  for (int i = 0; i < n; i++) {
    Serial.print(F("  ")); Serial.print(WiFi.SSID(i));
    Serial.print(F(" ch")); Serial.print(WiFi.channel(i));
    Serial.print(F(" rssi")); Serial.print(WiFi.RSSI(i));
    Serial.print(F(" enc")); Serial.print((int)WiFi.encryptionType(i));
    Serial.print(F(" bssid ")); Serial.print(WiFi.BSSIDstr(i));
    Serial.println();
  }

  // 2) CONNECT — real-credential test. Find a pure WPA2-CCMP (enc4)
  //    HOUSLEcz AP (the cipher the ESP8266 can actually authenticate
  //    against; the enc8 "AUTO" APs are WPA3/PMF it cannot do), BSSID-lock
  //    onto it, and connect with the real TEST_PASS. After flashing
  //    esp_init_data_default_v08 to the init-data sector, this should reach
  //    WL_CONNECTED (3) instead of watchdog-resetting.
  int pick = -1;
  for (int attempt = 0; attempt < 6 && pick < 0; attempt++) {
    for (int i = 0; i < n; i++) {
      if (WiFi.SSID(i) == TEST_SSID && WiFi.encryptionType(i) == ENC_TYPE_CCMP) {
        pick = i; break;
      }
    }
    if (pick < 0) {
      Serial.print(F("rescan ")); Serial.println(attempt + 1);
      delay(500);
      n = WiFi.scanNetworks(false, false);
    }
  }
  if (pick < 0) {
    Serial.println(F("NO_CCMP_AP giving up"));
    return;
  }
  Serial.print(F("CONNECT_BEGIN bssid ")); Serial.print(WiFi.BSSIDstr(pick));
  Serial.print(F(" ch")); Serial.print(WiFi.channel(pick));
  Serial.print(F(" enc")); Serial.println((int)WiFi.encryptionType(pick));

  WiFi.begin(TEST_SSID, TEST_PASS, WiFi.channel(pick), WiFi.BSSID(pick), true);

  uint8_t last = 99;
  unsigned long t0 = millis();
  while (millis() - t0 < 20000) {
    uint8_t st = WiFi.status();
    if (st != last) {
      Serial.print(F("status ")); Serial.print(st);
      Serial.print(F(" @")); Serial.print((millis() - t0) / 1000); Serial.println(F("s"));
      last = st;
    }
    if (st == WL_CONNECTED) break;
    delay(200);
    yield();
  }
  if (WiFi.status() == WL_CONNECTED) {
    Serial.print(F("SMOKE_WIFI_OK IP=")); Serial.println(WiFi.localIP());
  } else {
    Serial.print(F("SMOKE_WIFI_FAIL status=")); Serial.println(WiFi.status());
  }
}

void loop() {
  delay(1000);
  Serial.print(F("ALIVE status="));
  Serial.println(WiFi.status());
}
